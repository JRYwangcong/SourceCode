## MST9U13_Sceptre_20170719/MST9U_Sboot/Config.in
```kconfig
#
# For a description of the syntax of this configuration file,
# see scripts/kbuild/config-language.txt.
#

mainmenu "SBoot Configuration"

config HAVE_DOT_CONFIG
	bool
	default y

menu "Platform Configuration"

choice
	prompt "MStar Chip Family"
	default MSTAR_MST9U

config MSTAR_MST9U
	bool "MST9U"

config MSTAR_AMBER7
  bool "Amber 7"

config MSTAR_MACAW12
	bool "Macaw12"

endchoice

#===================================================
# MStar Chip Name (auto-select)
#===================================================
config MSTAR_CHIP_NAME
	string
	default "MST9U" if MSTAR_MST9U
    default "amber7" if MSTAR_AMBER7
	default "macaw12" if MSTAR_MACAW12
	default "error"

choice
	prompt "CPU Core Selection"

	config MCU_MIPS32
		bool "MIPS32"
		depends on (!MSTAR_JANUS && !MSTAR_MARIA10 && !MSTAR_MACAW12 && !MSTAR_MST9U && !MSTAR_AMBER3 && !MSTAR_AGATE && !MSTAR_EAGLE)

#	config MCU_AEON
#		bool "AEON for Test"

	config MCU_ARM
		bool "ARM"
		depends on (MSTAR_AMBER3 || MSTAR_AGATE || MSTAR_EAGLE)

	config MCU_AEONR2
		bool "AEON R2 Only"
		depends on (MSTAR_JANUS || MSTAR_MARIA10 || MSTAR_MACAW12 || MSTAR_MST9U)

endchoice

choice
	prompt "Booting mode"
	default BOOTING_FROM_EXT_SPI_WITH_CPU
	config BOOTING_FROM_EXT_SPI_WITH_CPU
		bool "CPU Booting from external SPI"
if(MSTAR_TITANIA12)||(MSTAR_AMBER7)||(MSTAR_AMBER3)||(MSTAR_AGATE) || (MSTAR_EAGLE) || (MSTAR_AMBER5)
	config BOOTING_FROM_EXT_SPI_WITH_PM51
		bool "PM51 Booting from external SPI"

    config BOOTING_FROM_OTP_WITH_PM51
		bool "PM51 Booting from internal OTP"
endif
endchoice



choice
	prompt "CPU Clock Selection"

	default CPU_345MHZ if(MSTAR_MST9U)
	default CPU_384MHZ if(MSTAR_JANUS)
	default CPU_600MHZ if(MSTAR_JANUS2)
	default CPU_576MHZ if((MSTAR_AMBER1) || (MSTAR_AMBER7) || (MSTAR_AMETHYST))
	default CPU_720MHZ if(MSTAR_AMBER2)
	default CPU_900MHZ if((MSTAR_AMBER3) || (MSTAR_AGATE))
	default CPU_900MHZ if(MSTAR_AMBER5)
	default CPU_456MHZ if(MSTAR_AMBER6)
	default CPU_216MHZ if(MSTAR_MARIA10)
	default CPU_216MHZ if(MSTAR_MACAW12)
	default CPU_696MHZ if(MSTAR_KRONUS)
	default CPU_312MHZ if((MSTAR_TITANIA4) || (MSTAR_TITANIA7))
	default CPU_672MHZ if((MSTAR_TITANIA8) || (MSTAR_TITANIA12))
	default CPU_552MHZ if((MSTAR_TITANIA9) || (MSTAR_TITANIA13) || (MSTAR_URANUS4))
	default CPU_792MHZ if(MSTAR_KAISERIN)
	default CPU_900MHZ if(MSTAR_EAGLE)

	config CPU_345MHZ
		bool "345MHz"
		help
		    CPU Clock: 345MHz

	config CPU_320MHZ
		bool "320MHz"
		help
		    CPU Clock: 320MHz

	config CPU_288MHZ
		bool "288MHz"
		help
		    CPU Clock: 288MHz

	config CPU_240MHZ
		bool "240MHz"
		help
		    CPU Clock: 240MHz

	config CPU_216MHZ
		bool "216MHz"
		help
		    CPU Clock: 216MHz

	config CPU_192MHZ
		bool "192MHz"
		help
		    CPU Clock: 192MHz

	config CPU_144MHZ
		bool "144MHz"
		help
		    CPU Clock: 144MHz

	config CPU_108MHZ
		bool "108MHz"
		help
		    CPU Clock: 108MHz

	config MSTAR_MANUAL
		bool "Manual Setting"
		help
		    CPU Clock: Manual Setting

endchoice

config MSTAR_OTHERS
    int "Please Input CPU Clock by Decimalism"
    default "552"
    depends on MSTAR_MANUAL
    help
        Set specific CPU clock by user

choice
	prompt "Board Selection"

	default MSTAR_MST9U_BD_MSTxxxA_DxxA_S if MSTAR_MST9U
	default MSTAR_MACAW12_BD_MST149A_D01A_S if MSTAR_MACAW12

	config MSTAR_BD_FPGA
		bool "BD_FPGA"

	if (MSTAR_MST9U)
		config MSTAR_MST9U_BD_MSTxxxA_DxxA_S
			bool "BD_MSTxxxA_DxxA_S"
	endif
endchoice

choice
	prompt "MStar Panel Selection"
	default PNL_WXGA_AU20_T200XW02

config PNL_FULLHD_SEC_LE32A
        bool "PNL_FULLHD_SEC_LE32A"
config PNL_SXGA_AU17_EN05
        bool "PNL_SXGA_AU17_EN05"
config PNL_WXGA_AU20_T200XW02
        bool "PNL_WXGA_AU20_T200XW02"
config PNL_WXGA_PLUS_CMO190_M190A1
        bool "PNL_WXGA_PLUS_CMO190_M190A1"
config PNL_WSXGA_AU22_M201EW01
        bool "PNL_WSXGA_AU22_M201EW01"
config PNL_FULLHD_CMO216_H1L01
        bool "PNL_FULLHD_CMO216_H1L01"
config PANEL_RES_FULL_HD
        bool "PANEL_RES_FULL_HD"
config PNL_WUXGA_CMO260_J2
        bool "PNL_WUXGA_CMO260_J2"
config MFC120_FULLHD_CMO216_H1L01
        bool "MFC120_FULLHD_CMO216_H1L01"
config MFC60_FULLHD_CMO216_H1L01
        bool "MFC60_FULLHD_CMO216_H1L01"
config PNL_FULLHD_TCON
        bool "PNL_FULLHD_TCON"
config PNL_DACOUT_576I
        bool "PNL_576I"
config PNL_DACOUT_576P
        bool "PNL_576P"
config PNL_DACOUT_720P_50
        bool "PNL_720P_50"
config PNL_DACOUT_1080I_50
        bool "PNL_1080I_50"
config PNL_DACOUT_1080P_50
        bool "PNL_1080P_50"
config PNL_DACOUT_480I
        bool "PNL_480I"
config PNL_DACOUT_480P
        bool "PNL_480P"
config PNL_DACOUT_720P_60
        bool "PNL_720P_60"
config PNL_DACOUT_1080I_60
        bool "PNL_1080I_60"
config PNL_DACOUT_1080P_60
        bool "PNL_1080P_60"
endchoice

choice
	prompt "Memory Map Type Selection"

    default MSTAR_MST9U_MMAP_512MB if (MSTAR_MST9U)

	config MSTAR_TITANIA_MMAP_128MB_128MB_DEFAULT
	depends on ((!MSTAR_MACAW12) && (!MSTAR_MST9U))
		bool "128MB_128MB_DEFAULT"

	if (MSTAR_MST9U)
	config MSTAR_MST9U_MMAP_512MB
		bool "MST9U 512MB DDR3"
	config MSTAR_MST9U_MMAP_256MB
		bool "MST9U 256MB DDR3"

	endif

endchoice

choice
 	prompt "Memory Frequency Selection"
    depends on !((MSTAR_AMBER7) || (MSTAR_AMETHYST) || (MSTAR_EAGLE))

	default MEM2133MHz if MSTAR_MST9U
	default MEM1066MHz if MSTAR_URANUS4
	default MEM800MHz  if MSTAR_TITANIA4
	default MEM1066MHz if MSTAR_TITANIA7
	default MEM1066MHz if MSTAR_TITANIA8
	default MEM1066MHz if MSTAR_TITANIA12
	default MEM1300MHz if MSTAR_AMBER2
	default MEM1300MHz if MSTAR_AGATE
	default MEM1300MHz if MSTAR_AMBER3
	default MEM1300MHz if MSTAR_AMBER5
	default MEM1300MHz if MSTAR_TITANIA9
	default MEM1300MHz if MSTAR_TITANIA13
	default MEM1300MHz if MSTAR_AMBER1
	default MEM1066MHz if MSTAR_AMBER6
	default MEM1066MHz if MSTAR_JANUS
	default MEM1300MHz if MSTAR_JANUS2
	default MEM1066MHz if MSTAR_MARIA10
	default MEM800MHz if MSTAR_MACAW12
	default MEM1600MHz if MSTAR_KRONUS
	default MEM1066MHz if MSTAR_KAISERIN

    if(MSTAR_MST9U)
    config MEM2133MHz
        bool "2133 MHz"

    config MEM1866MHz
        bool "1866 MHz"
        
    config MEM1333MHz
        bool "1333 MHz"

    config MEM1240MHz
        bool "1240 MHz"
    endif

    if(!MSTAR_JANUS && !MSTAR_MARIA10)
    config MEM1600MHz
        bool "1600 MHz"
	config MEM1300MHz
		bool "1300 MHz"
    endif

	config MEM1066MHz
		bool "1066 MHz"

endchoice

choice
    prompt "DDR3 Mode Configuration"
	depends on (MSTAR_KRONUS)
	default DDR3_16BIT_MODE
	config   DDR3_16BIT_MODE
	    bool "DDR3 16-BIT MODE"
	config   DDR3_8BIT_MODE
	    bool "DDR3 8-BIT MODE"
endchoice

choice
 	prompt "MIU0 DRAM Selection"
 	depends on ((MSTAR_AMBER7) || (MSTAR_AMETHYST) || (MSTAR_EAGLE))
	default MIU0_DDR3_1333 if MSTAR_AMBER7
	default MIU0_DDR3_1333 if MSTAR_AMETHYST
	default MIU0_DDR3_1666 if MSTAR_EAGLE

    config MIU0_DRAM_NONE
		bool "None"

	config MIU0_DDR3_1666
		bool "DDR3-1666"

	config MIU0_DDR3_1333
		bool "DDR3-1333"

	config MIU0_DDR3_1066
		bool "DDR3-1066"

	config MIU0_DDR2_1066
		bool "DDR2-1066"

	config MIU0_DDR2_800
		bool "DDR2-800"
endchoice

choice
 	prompt "MIU1 DRAM Selection"
 	depends on ((MSTAR_AMBER1) || (MSTAR_AMBER6) || (MSTAR_AMBER7) || (MSTAR_AMETHYST) || (MSTAR_EAGLE))
	default MIU1_DDR3_1333 if MSTAR_AMBER1
	default MIU1_DRAM_NONE if MSTAR_AMBER6
	default MIU1_DDR3_1333 if MSTAR_AMBER7
	default MIU1_DDR3_1333 if MSTAR_AMETHYST
	default MIU1_DDR3_1666 if MSTAR_EAGLE

    config MIU1_DRAM_NONE
		bool "None"

	config MIU1_DDR3_1666
		bool "DDR3-1666"

	config MIU1_DDR3_1333
		bool "DDR3-1333"

	config MIU1_DDR3_1066
		bool "DDR3-1066"

	config MIU1_DDR2_1066
		bool "DDR2-1066"

	config MIU1_DDR2_800
		bool "DDR2-800"
endchoice

config ENABLE_MIU_SWAP
    bool "Enable MIU0/MIU1 Swap Function"
    default n
    depends on MSTAR_AMBER7
	help
	    Swap MIU0 / MIU1

choice
	prompt "BIST Length Selection"

	default BIST_0x1001_UNITS

	config BIST_0x0401_UNITS
		bool "0x0401 units"
		help
		    BIST Length: 0x0401 units

	config BIST_0x1001_UNITS
		bool "0x1001 units"
		help
		    BIST Length: 0x1001 units

	config BIST_0x8001_UNITS
		bool "0x8001 units"
		help
		    BIST Length: 0x8001 units
endchoice

config BOOTRAM_LOADADDR
	hex "SBOOT BOOTRAM Memory Address"
    default 0x01000000 if (MSTAR_MST9U)
	default 0x81000000 if (!MSTAR_JANUS)
    default 0x01000000 if (MSTAR_JANUS)
	default 0x80500000 if (!MSTAR_JANUS)&&(BOOTING_FROM_OTP_WITH_PM51)
	default 0x80204C00 if (!MSTAR_JANUS)&&(!BOOTING_FROM_OTP_WITH_PM51)
	help
	  The address to load ram stage bootloader (usually bootram.S)
	  - Please note this should not overlap with decompressor or u-boot

config UBOOT_LOADADDR
	hex "UBOOT BOOTRAM Memory Address"
	default 0x41200000
	help
	  The address to load u-boot before relocation

config DRAM_SIZE_MB_RELOCATE
	int "DRAM Size for UBoot relocation (MB)"
	default 256
	help
	  The dram size for Uboot relocation

config MSTAR_STR_ENABLE
  bool "Enable MStar STR"
  default false
  help
    Enable MStar STR

if (BOOTING_FROM_OTP_WITH_PM51)
config PM_DRAM_ADDRESS
	hex "PM in DRAM Address"
	default 0x87FF0000
    help

config CUSTOMER_KEY_BANK_DRAM_ADDRESS
	hex "Customer key bank in DRAM Address"
	default 0xA0300000
    help

config SECURE_INFO_DRAM_ADDRESS
	hex "SECURE INFO in DRAM Address"
	default 0xA0400000
    help

endif

if ((MSTAR_TITANIA9) || (MSTAR_TITANIA13) || (MSTAR_AMBER1) || (MSTAR_AMBER6) || (MSTAR_AMBER7) || \
    (MSTAR_JANUS2) || (MSTAR_AMBER5) || (MSTAR_AMETHYST) || (MSTAR_KRONUS) || (MSTAR_EAGLE))

menu "Extended CPU Configuration"

if (MCU_ARM)

config MSTAR_MOBF_ENABLE
    bool "Enable MOBF Function"
    default n
    depends on MSTAR_EAGLE
	help
	    Enable MOBF Function

config MSTAR_ASIC_EMULATION_ENABLE
    bool "Enable ASIC Emulation"
    default n
    depends on MSTAR_EAGLE
	help
	    Enable ASIC Emulation

endif   #// MCU_ARM

if (MCU_MIPS32)

choice
 	prompt "MIPS Core Type"
	default MSTAR_MIPS_SINGLE_CORE
	depends on MSTAR_JANUS2

	config MSTAR_MIPS_SINGLE_CORE
		bool "Single Core"

	config MSTAR_MIPS_DUAL_CORE
		bool "Dual Core"
endchoice

choice
 	prompt "MIPS VPE Type"
	default MSTAR_MIPS_SINGLE_VPE_PER_CORE if MSTAR_MIPS_SINGLE_CORE
	default MSTAR_MIPS_DUAL_VPE_PER_CORE if MSTAR_MIPS_DUAL_CORE
	depends on MSTAR_JANUS2

	config MSTAR_MIPS_SINGLE_VPE_PER_CORE
		bool "Single VPE per Core"

	config MSTAR_MIPS_DUAL_VPE_PER_CORE
		bool "Dual VPE per Core"
endchoice

choice
 	prompt "OCP Clock Ratio"
	default MSTAR_MIPS_OCP_CLOCK_RATIO_1_2
	depends on MSTAR_JANUS2

	config MSTAR_MIPS_OCP_CLOCK_RATIO_1_1
		bool "MIPS : OCP = 1 : 1"

	config MSTAR_MIPS_OCP_CLOCK_RATIO_1_2
		bool "MIPS : OCP = 1 : 2"

	config MSTAR_MIPS_OCP_CLOCK_RATIO_1_3
		bool "MIPS : OCP = 1 : 3"

	config MSTAR_MIPS_OCP_CLOCK_RATIO_1_4
		bool "MIPS : OCP = 1 : 4"

	config MSTAR_MIPS_OCP_CLOCK_RATIO_1_5
		bool "MIPS : OCP = 1 : 5"
endchoice

config MSTAR_L2_CACHE_ENABLE
    bool "Enable MIPS L2 Cache Mechanism"
    default n
    depends on ((MSTAR_JANUS2) || (MSTAR_AMBER5) || (MSTAR_AMETHYST))
	help
	    Enable / Disable MIPS L2 Cache Mechanism

config MSTAR_CPU_PREFETCH_ENABLE
    bool "Enable CPU Prefetch Buffer"
    default y
    depends on !(MSTAR_KRONUS)
	help
	    Enable / Disable Prefetch Buffer

choice
	prompt "L2 Cache Size Selection"
	default MSTAR_TITANIA_L2_CACHE_256K_BYTES
	depends on ((MSTAR_JANUS2) && (MSTAR_CPU_PREFETCH_ENABLE || MSTAR_L2_CACHE_ENABLE))

 	config MSTAR_TITANIA_L2_CACHE_128K_BYTES
		bool "128K-Byte"
    	help
    	    L2 Cache Size: 128K-Byte

 	config MSTAR_TITANIA_L2_CACHE_256K_BYTES
		bool "256K-Byte"
    	help
    	    L2 Cache Size: 256K-Byte
endchoice

choice
	prompt "L2 Cache Type Selection"
	default MSTAR_TITANIA_L2_CACHE_WRITE_BACK
	depends on (((MSTAR_JANUS2) || (MSTAR_AMBER5) || (MSTAR_AMETHYST)) && \
	            (MSTAR_CPU_PREFETCH_ENABLE || MSTAR_L2_CACHE_ENABLE))

 	config MSTAR_TITANIA_L2_CACHE_WRITE_BACK
		bool "Write Back"
    	help
    	    L2 Cache Type: Write Back

 	config MSTAR_TITANIA_L2_CACHE_WRITE_THROUGH
		bool "Write Through"
    	help
    	    L2 Cache Type: Write Through
endchoice

choice
	prompt "Cache Line Size Selection"
	default MSTAR_TITANIA_L2_CACHE_LINE_64_BYTES
	depends on (MSTAR_CPU_PREFETCH_ENABLE || MSTAR_L2_CACHE_ENABLE)

 	config MSTAR_TITANIA_L2_CACHE_LINE_32_BYTES
		bool "32-Byte"
		depends on !(MSTAR_JANUS2 || MSTAR_AMBER5 || MSTAR_AMETHYST)
    	help
    	    Prefetch Buffer: Cache Line Size: 32-Byte

 	config MSTAR_TITANIA_L2_CACHE_LINE_64_BYTES
		bool "64-Byte"
    	help
    	    Prefetch Buffer: Cache Line Size: 64-Byte

 	config MSTAR_TITANIA_L2_CACHE_LINE_128_BYTES
		bool "128-Byte"
		depends on (MSTAR_JANUS2 || MSTAR_AMBER5 || MSTAR_AMETHYST)
    	help
    	    Prefetch Buffer: Cache Line Size: 128-Byte

 	config MSTAR_TITANIA_L2_CACHE_LINE_256_BYTES
		bool "256-Byte"
		depends on (MSTAR_JANUS2)
    	help
    	    Prefetch Buffer: Cache Line Size: 256-Byte

endchoice

choice
	prompt "Preferch Buffer Line Size Selection"
	default MSTAR_TITANIA_PREFETCH_LINE_32_BYTES
	depends on ((MSTAR_AMBER5) || (MSTAR_AMETHYST)) && (MSTAR_CPU_PREFETCH_ENABLE)

 	config MSTAR_TITANIA_PREFETCH_LINE_32_BYTES
		bool "32-Byte"
    	help
    	    Prefetch buffer Line size : 2x128(32Byte)

 	config MSTAR_TITANIA_PREFETCH_LINE_64_BYTES
		bool "64-Byte"
    	help
    	    Prefetch buffer Line size : 4x128(64Byte)
endchoice

config MSTAR_MEMORY_PREFETCH_ENABLE
    bool "Enable Memory Prefetch Mechanism"
    default n
    depends on (MSTAR_AMBER1 || MSTAR_JANUS2 || MSTAR_AMBER5 || MSTAR_AMBER7 || MSTAR_AMETHYST)
	help
	    Enable / Disable Memory Prefetch Mechanism

config MSTAR_FORCE_REQUEST_INTO_CACHE
    bool "Force All MIU Requests into Cache"
    depends on !(MSTAR_JANUS2 || MSTAR_AMBER5 || MSTAR_AMETHYST || MSTAR_KRONUS)
    default n
	help
	    Enable / Disable to Force All MIU Requests into Cache

config MSTAR_MIU_HIGHWAY_ENABLE
    bool "Enable MIU Highway Mechanism"
    default n
    depends on (MSTAR_JANUS2 || MSTAR_AMBER5)
	help
	    Enable / Disable MIU Highway Mechanism

config MSTAR_32BIT_RIU_MASK_ENABLE
    bool "Enable 32-bit RIU Mask Mechanism"
    default n
    depends on !(MSTAR_TITANIA9 || MSTAR_JANUS2)
	help
	    Enable / Disable 32-bit RIU Mask Mechanism

config MSTAR_TLB_SHARE_ENABLE
    bool "Enable TLB Sharing Mechanism"
    default n
    depends on MSTAR_TITANIA13
	help
	    Enable / Disable TLB Sharing Mechanism

config MSTAR_TITANIA_MIU1_ENABLE
    bool "Enable Memory Interface Unit 1 (MIU1)"
    default y
    depends on ((MSTAR_TITANIA_MMAP_128MB_128MB_DEFAULT || \
                 MSTAR_TITANIA_MMAP_256MB_256MB_DEFAULT || \
		         MSTAR_TITANIA_MMAP_128MB_128MB || \
                 MSTAR_TITANIA_MMAP_128MB_64MB || \
                 MSTAR_TITANIA_MMAP_64MB_128MB || \
                 MSTAR_TITANIA_MMAP_64MB_64MB || \
                 MSTAR_TITANIA_MMAP_256MB_256MB || \
                 MSTAR_TITANIA_MMAP_512MB_512MB) && \
                 (MSTAR_TITANIA13 || MSTAR_JANUS2))
    help
        Enable / Disable Memory Interface Unit 1 (MIU1)

endif   #// MCU_MIPS32

endmenu

endif

endmenu

menu "General Configuration"

###
### config NEXT_IMAGE_FILE
###	 string "Next Stage Image File"
###	 default "../u-boot-1.1.6/u-boot.bin"
###	 help
### 	  Next stage image file
### 	  Usually it is
### 		1. u-boot.bin
### 		2. binary from vmlinux (objcopy -O binary vmlinux vmlinux.bin)
###

choice
	prompt "Buffer allocation policy"
	default FEATURE_BUFFERS_USE_MALLOC
	help
	  There are 3 ways SBoot can handle buffer allocations:
	  - Use malloc. This costs code size for the call to xmalloc.
	  - Put them on stack. For some very small machines with limited stack
		space, this can be deadly. For most folks, this works just fine.
	  - Put them in BSS. This works beautifully for computers with a real
		MMU (and OS support), but wastes runtime RAM for uCLinux. This
		behavior was the only one available for SBoot versions 0.48 and
		earlier.

config FEATURE_BUFFERS_USE_MALLOC
	bool "Allocate with Malloc"

config FEATURE_BUFFERS_GO_ON_STACK
	bool "Allocate on the Stack"

config FEATURE_BUFFERS_GO_IN_BSS
	bool "Allocate in the .bss section"

endchoice

config UART1_SEL
        bool "UART1 Enable"
        default n

config EMMC_BOOT
        bool "MIPS boot from eMMC"
        default n

config SBOOT_TO_KERNEL
        bool "Sboot to kernel"
        default n

if (SBOOT_TO_KERNEL)
choice
        prompt "Kernel Selection"
        default None
config KERNEL_2_6_28_9
        bool "2.6.28.9"
config KERNEL_2_6_32_15
        bool "2.6.32.15"
config KERNEL_2_6_35_11
        bool "2.6.35.11"

endchoice
endif

config SHOW_USAGE
	bool "Show terse applet usage messages"
	default y
	help
	  All SBoot applets will show help messages when invoked with
	  wrong arguments. You can turn off printing these terse usage
	  messages if you say no here.
	  This will save you up to 7k.

config NON_OS
	bool "Build bootloader without U-Boot (Non-OS)"
	default y
	help
	  Build the bootloader with Non-OS system.

if (NON_OS)
config SBOOT_USE_BDMA_TO_CHECK_CRC
        bool "Sboot uses BDMA to check CRC"
        default y if (MSTAR_TITANIA_BD_MSD380B_D01A || \
            MSTAR_TITANIA_BD_MSD523B_D01A)
        depends on (MSTAR_TITANIA4 || \
            MSTAR_TITANIA7 || \
            MSTAR_TITANIA8 || \
            MSTAR_TITANIA9 || \
            MSTAR_TITANIA12 || \
            MSTAR_TITANIA13 || \
            MSTAR_AMBER1 || \
            MSTAR_AMBER7)
        help
          If enable this option, sboot would compare the CRC
          stored in the AP image with the CRC calculated from the
          AP. It should be only applicable to Non-OS project.
          It is default on on AEON based CPUs.

config SECURE_BOOT
	bool "Secure Boot"
	default n
	help
	  Secure Boot.
endif

config COMPRESSED_UBOOT
	bool "Build bootloader with compressed U-Boot"
	default n
	help
	  Build the bootloader with compressed U-Boot.

if (MSTAR_MARIA10)
config MSTAR_MARIA10_PM
	bool "Build PM binary"
	default n
	help
	  Build PM binary for sleep(saving) mode.
endif

if (MSTAR_MACAW12)
config MSTAR_MACAW12_PM
	bool "Build PM binary"
	default n
	help
	  Build PM binary for sleep(saving) mode.
endif

endmenu

menu 'Build Options'

### config BUILD_AT_ONCE
###	bool "Compile all sources at once"
###	default n
###	help
###	  Normally each source-file is compiled with one invocation of
###	  the compiler.
###	  If you set this option, all sources are compiled at once.
###	  This gives the compiler more opportunities to optimize which can
###	  result in smaller and/or faster binaries.
###
###	  Setting this option will consume alot of memory, e.g. if you
###	  enable all applets with all features, gcc uses more than 300MB
###	  RAM during compilation of busybox.
###
###	  This option is most likely only beneficial for newer compilers
###	  such as gcc-4.1 and above.
###
###	  Say 'N' unless you know what you are doing.

### config KERNEL_SOURCE_DIR
### 	string "Kernel Source directory"
### 	default "../../RedLion/2.6.28.9"
### 	help
### 	  Kerenl source directory need by sboot
###
### 	  linux-2.6.28.9:	../../RedLion/2.6.28.9
### 	  linux-2.6.26:		../../RedLion/2.6.26
###
### 	  This option will be removed later

config CROSS_COMPILER_PREFIX
	string "Cross Compiler prefix"
	default "mips-linux-gnu-" if (MCU_MIPS32)
	default "aeon-" if (MCU_AEONR2||MCU_AEON)
	default "arm-none-eabi-" if (MCU_ARM)

	help
	  If you want to build SBoot with a cross compiler, then you
	  will need to set this to the cross-compiler prefix, for example,
	  "mips-linux-gnu-" or "aeon-"

	  Note that CROSS_COMPILE environment variable or
	  "make CROSS_COMPILE=xxx ..." will override this selection.

	  Native builds leave this empty.

config EXTRA_CFLAGS
	string "Additional CFLAGS"
	default "-EL" if MCU_MIPS32
	default "-march=aeon1 -EL" if MCU_AEON
	default "-march=aeonR2 -EL" if (MCU_AEONR2)
	help
	  Additional CFLAGS to pass to the compiler verbatim.

config EXTRA_AFLAGS
	string "Additional AFLAGS"
	help
	  Additional AFLAGS (for assembly files) to pass to
	  the compiler verbatim.

endmenu

menu 'Debugging Options'

config DEBUG
	bool "Build SBoot with extra Debugging symbols"
	default n
	help
	  Say Y here if you wish to examine SBoot internals while applets are
	  running. This increases the size of the binary considerably, and
	  should only be used when doing development. If you are doing
	  development and want to debug SBoot, answer Y.

	  Most people should answer N.

config DEBUG_PESSIMIZE
	bool "Disable compiler optimizations"
	default n
	depends on DEBUG
	help
	  The compiler's optimization of source code can eliminate and reorder
	  code, resulting in an executable that's hard to understand when
	  stepping through it with a debugger. This switches it off, resulting
	  in a much bigger executable that more closely matches the source
	  code.

config WERROR
	bool "Abort compilation on any warning"
	default n
	help
	  Selecting this will add -Werror to gcc command line.

	  Most people should answer Y.

config EARLY_DISABLE_UART
	bool "Early disable uart"
	default n
	help
	  Selecting this will disable uart in the early stage of u-boot.
	  Most people should answer N.

endmenu

menu 'Installation Options'

config PREFIX
	string "SBoot installation prefix"
	default "./_install"
	help
	  Define your directory to install SBoot files/subdirs in.

endmenu

menu 'Module Options'
if (MSTAR_AMBER3) || (MSTAR_EAGLE)
config ANDROID_SUPPORT
	bool "Android Support"
	default n
	help
	  Selecting this item will enable Android options.

if(ANDROID_SUPPORT)
config ANDROID_BOOT
        bool "Android Boot"
        default n
        help
        Enable support to recovery, upgrade bootloader mode
endif
endif

config USB
	bool "USB"
	default n
	help
	  Selecting this item will enable USB cmd.

if (USB)
config USB_LAN
	bool "USB_LAN"
	default n
	help
	  Selecting this item will enable USB LAN cmd.
endif

config FLASH_TYPE
	bool "Flash Type"
	default y
	help
		Enable to select flash type. Unused flag.
if(FLASH_TYPE)
config NAND_FLASH
	bool "NAND Flash"
	default y
	help
	  Selecting this item will enable NAND flash cmd.
#	  Warning! Don't select "Serial Flash" and "NAND Flash" at the same time.

if(NAND_FLASH)
config BFN_WRITE_NAND
        bool "BFN_WRITE_NAND"
        default n
        help
        Enable NAND CMD to write BFN BIN files, MIU,LDR,UBOOT

config BOOT_FROM_NAND
	bool "Boot from nand flash"
	default n
	depends on (!BFN_WRITE_NAND)
	help

endif

config MMC
    bool "MMC"
    default n
    help
        selecting this item will enable support embeded-MMC device feature.

if((!BOOT_FROM_NAND)&&(!FLASH))
config BOOT_FROM_EMMC
	bool "Boot from e-MMC"
	default n
	depends on (MMC)
	help
	  Selecting this item, all system will be stored in e-MMC.
#	  Warning! Don't select "Serial Flash" and "NAND Flash" and "e-MMC" at the same time.
endif
endif

#if(!BOOT_FROM_NAND)
config SPI
	bool "SPI"
	default n
	help
	  Selecting this item will enable SPI flash cmd.
#endif

if(!BOOT_FROM_NAND)&&(SPI)
config FLASH
	bool "Serial Flash"
	default n
	help
	  Selecting this item, all system will be stored in spi flash.
#	  Warning! Don't select "Serial Flash" and "NAND Flash" at the same time.
endif

if (NAND_FLASH)
config UBI
    bool "UBI"
    default y
    help

endif

if(UBI)
config UBI_MLC_BACKUP_LSB
    bool "  UBI MLC Backup LSB"
    default n
    help
		UBI backup lsb mechanism for MLC NAND

config UBI_ENHANCE_INIT
	bool "  UBI scan speed up"
	default n
	help
		Speed up only one selected mtd parition for ubi_scan
endif

config FILE_SYSTEM
	bool "File System"
	default y
	help
		Enable to select file system. Unused flag.

if (FILE_SYSTEM)
if ((USB) || (MMC))
config FAT
	bool "FAT"
	default n
	help
	  Selecting this item will enable FAT cmd.
endif

if (UBI)
config UBI_FS
    bool "UBI File System"
    default y
    help

endif

config JFFS2
    bool "JFFS2"
    default y
    help

if((USB) || (MMC))
config CMD_EXT2
	bool "EXT2"
	default n
	help
	  Selecting this item will enable EXT2 cmd.
config CMD_EXT4
	bool "EXT4"
	default n
	depends on CMD_EXT2
	help
	  Selecting this item will enable EXT4 cmd.
config CMD_EXT4_WRITE
	bool "EXT4 Write Support"
	default n
	depends on CMD_EXT4
	help
	  Selecting this item will enable EXT4 Write cmd.
endif
endif

config KEYPAD
	bool "Keypad"
	default n
	help
	  Selecting this item will enable Keypad, Header and ELF cmd.
if (MSTAR_AMBER3) || (MSTAR_EAGLE)
if(KEYPAD)
config BOOT_KEYPAD
    bool "  BOOT_KEYPAD"
    default n
    help
      Selecting this item will enable BOOT_KEYPAD cmd,
      thus you can select boot mode via KEYPAD.
endif
endif

if (MSTAR_AMBER3) || (MSTAR_EAGLE)
config IR
	bool "IR"
	default n
	help
	  Selecting this item will enable IR cmd.
if(IR)
config BOOT_IR
    bool "BOOT_IR"
    default n
    help
      Selecting this item will enable BOOT_IR cmd,
      thus you can select boot mode via IR.
endif
endif

config SECURITY_BOOT
    bool "Security"
    default n
    help

if (SECURITY_BOOT)
menu 'Security Options'

config SECURE_AESDMA
	bool "Enhance Secure booting"
	default n
	help

config SECURE_PARTIAL_AUTHENTICATION
	bool "Secure_Partial_authentication"

config SECURE_USB_UPGRADE
	bool "Secure USB Upgrade"
        default n
        help

config SECURE_DEBUG_MESSAGE
	bool "Secure Debug Message"
        default n
        help

config SECURE_SPI_PROTECT
	bool "Enable SPI Protect"
	default n
	help

if (SECURE_SPI_PROTECT)
menu 'SPI Protect Options'

config BOOTING_ACTIVE_SPI_PROTECT
	bool "Active SPI Protect in u-boot"
	default n
	help

choice
    depends on SECURE_SPI_PROTECT
	prompt "SECURE_SPI_PROTECT_TYPE"
	default SECURE_SPI_PARTIAL_PROTECT
        config SECURE_SPI_PARTIAL_PROTECT
			bool "SECURE_SPI_PARTIAL_PROTECT"
		config SECURE_SPI_FULL_PROTECT
			bool "SECURE_SPI_FULL_PROTECT"
	help
        SECURE_SPI_FULL_PROTECT can't used with ENV_IN_SERIAL
endchoice

if (SECURE_SPI_PARTIAL_PROTECT)
menu 'SPI Protect/Non-Protect Area Setting'

config SECURE_SPI_PROTECT_SPACE
	hex "SPI Protect Space Length, Reserved from start of SPI"
	default 0xC0000 if (COMPRESSED_UBOOT)
	default 0x120000
	help
	  The value must greater than MBoot length
	  Please re-tune the value if make MBoot fail

config SECURE_SPI_NON_PROTECT_SPACE
	hex "SPI Non-Protect Space Length, Reserved from end of SPI"
	default 0x0
        help
	  The value will effect the result of partial protect
	  When partial protect active fail
	  Please re-tune the value or use full protect
	  It will auto reserved 7/3 more bank for MBoot

endmenu
endif

endmenu
endif

endmenu
endif

config LZO
	bool "LZO"
	default n
	help
	  Selecting this item will enable LZO compress.

if (LZO)
config UNLZO_DST_ADDR
	hex "LZO Uncompress Dst Memory Address"
	default 0x5f000000
	help
	  The address to store lzo uncompressed data before writing to flash
endif

config DISPLAY_LOGO
	bool "DISPLAY_LOGO"
	default n
	help
	  Selecting this item will enable DISPLAY_LOGO cmd.
if (DISPLAY_LOGO)
choice
    prompt "Storage Device"
        default LOGO_STORE_IN_NAND_FLASH
        config LOGO_STORE_IN_SPI_FLASH
            bool "LOGO_STORE_IN_SPI_FLASH"
        config LOGO_STORE_IN_NAND_FLASH
            bool "LOGO_STORE_IN_NAND_FLASH"
        config LOGO_STORE_IN_EMMC_FLASH
            bool "LOGO_STORE_IN_EMMC_FLASH"
endchoice
choice
    prompt "GOP Destination Type"
    config GOP_OP_PATH
        bool "GOP_OP_PATH"
        help
          Using for GOP op path and GOP mixer to ve path
    config GOP_MIXER2OP_PATH
        bool "GOP_MIXER2OP_PATH"
        help
          Using for GOP mixer to op path
endchoice
config DISPLAY_LOGO_SPACE
	hex "DISPLAY_LOGO_SPACE"
	default 0x40000
	help
	  The value for booting logo
endif

config DISPLAY_OSD
	bool "DISPLAY_OSD"
	default n
	help
	  Selecting this item will DISPLAY_OSD cmd.
if (DISPLAY_OSD || DISPLAY_LOGO)
choice
	depends on (DISPLAY_OSD || DISPLAY_LOGO)
    prompt "BootLogo/BootOSD Output"
        default BOOTLOGO_OUT_CVBS
        config BOOTLOGO_OUT_CVBS
            bool "BOOTLOGO_OUT_CVBS"
            help
              Selecting this item will display boot logo/osd by using CVBS output.
        config BOOTLOGO_OUT_SCART_HD_DAC
            bool "BOOTOLOG_OUT_SCART_HD_DAC"
            help
              Selecting this item will display boot logo/osd by using SCART output
              and SCART CVBS on HD DAC.
        config BOOTLOGO_OUT_SCART_SD_DAC
            bool "BOOTOLOG_OUT_SCART_SD_DAC"
            help
              Selecting this item will display boot logo/osd by using SCART output
              and SCART CVBS on SD DAC.
endchoice
endif

config POWER_MUSIC
	bool "POWER_MUSIC"
	default n
	help
	Selecting this item will POWER_MUSIC .
if (POWER_MUSIC)
choice
	prompt "amplifier type"
	default SIM_Amplifier
	config DIGITAL_TI5711
		bool "TI5711"

	config DIGITAL_TI5707
		bool "TI5707"

	config DIGITAL_TI5708
		bool "TI5708"

	config DIGITAL_STA333
		bool "STA333"

	config SIM_Amplifier
		bool "sim_amplifier"
endchoice
endif

config FRONT_END
    bool "FrontEnd"
    default n
    help
      Selecting this item will enable front-end driver.
if (FRONT_END)
choice
	prompt "Tuner"
        config MSTAR_TUNER_NUTUNE_FT2125
			bool "NUTUNE_FT2125_TUNER"
		config MSTAR_TUNER_NUTUNE_FJ2207
			bool "NUTUNE_FJ2207_TUNER"
        config MSTAR_TUNER_NXP_TD1611ALF
            bool "NXP_TD1611ALF_TUNEr"
endchoice
choice
	prompt "DEMOD"
		config MSTAR_MSB123x_DEMOD
			bool "MSTAR_MSB123x_DEMOD"
        config MSTAR_MSB122x_DEMOD
            bool "MSTAR_MSB122x_DEMOD"
endchoice
config DEMUX
	bool "Demux"
	default y
	help
	  Selecting this item will enable demux driver.
endif

config NET
	bool "NET"
	default y
	help
	  Selecting this item will enable NET cmd.
if (NET)
config NETUPDATE
    bool "Network Upate"
    default n
    help
        selecting this item will enable network update feature.
endif

config PHY_SELECTION
	bool "PHY Selection"
	default y
	help
		Enable to select PHY. Unused flag.
if (PHY_SELECTION)
config ALBANY
	bool "MSTAR PHY"
	default n
	depends on MSTAR_JANUS
	help
		Selecting this item will enable Mstar PHY (Albany)

config ETHERNET_ALBANY
	bool "MStar Internal Ethernet PHY"
	default n
	depends on (MSTAR_JANUS2 || MSTAR_AMBER1 || MSTAR_AMBER2 || MSTAR_AMBER3 || MSTAR_AMBER5 || MSTAR_AMBER7 || MSTAR_AMETHYST || MSTAR_KAISERIN || MSTAR_EAGLE)
	help
		Enable MStar Internal Ethernet PHY (Albany)
endif

config OAD
    bool "OAD"
    default n
    help
        selecting this item will enable OAD (Over the Air Download) feature.

if (OAD)
choice
    prompt "Selection"
    default SUPERNOVA_OAD

    config OBAMA_OAD
        depends on OAD
               bool "Obama_OAD"
               help
                 Selecting this item will enable OAD base on Obama.

    config SUPERNOVA_OAD
        depends on OAD
               bool "Supernova_OAD"
               help
                 Selecting this item will enable OAD base on Supernova.

endchoice
    config OAD_IN_MBOOT
        depends on (OAD && SUPERNOVA_OAD)
               bool "OAD_In_MBoot"
               default n
               help
                 Selecting this item will enable OAD base on Supernova
                 and download in MBoot.
endif

config MTD_NAND_BBT
	bool "MTD NAND FLASH BASE BBT"
	default y
	help
		Selecting this item, bbt will be stored in nand flash.

config URSA_6M30
	bool "URSA_6M30"
	default n
	help
	  Selecting this item will enable URSA 6M30 cmd.

config PANEL_INIT
	bool "PANEL_INIT"
    default n
	help
	  Selecting this item will enable PANEL_INIT cmd.

config MSTARI2C
	bool "MSTARI2C"
	default n
	help
	  Selecting this item will enable MSTARI2C driver.

config EEPROM
	bool "EEPROM"
	default n
	help
	  Selecting this item will enable EEPROM cmd.

config STANDBY
	bool "STANDBY"
	default n
	help
	  Selecting this item will enter standby mode.

config VFS
	bool "VFS"
	default y
	help

config MICOM
	bool "Micom"
	default n
	help
	  Selecting this item will enable Micom cmd.

config WDT
    bool "Watchdog timer"
    default n
    help
        selecting this item will enable watchdog timer.

config BACKUP_PARTITION
	bool "backup partition"
	default n
	help
	  Selecting this item will enable backup partition.

choice
    prompt "Env Config"
    default ENV_IN_NAND if (NAND_FLASH)
    default ENV_IN_SERIAL if (FLASH)
    default ENV_IN_MMC if (MMC)
    if((!BOOT_FROM_NAND)&&(!BOOT_FROM_EMMC))
    config ENV_IN_SERIAL
        bool "Serial"
    endif

    if((!BOOT_FROM_NAND)&&(!FLASH))
    config ENV_IN_MMC
        bool "e-MMC"
    endif

    if (NAND_FLASH)
        config ENV_IN_NAND
        bool "Nand Flash"

        if (UBI && UBI_FS)
            config ENV_IN_UBI
                bool "Nand UBI"
        endif
    endif

    if((!BOOT_FROM_NAND)&&(!BOOT_FROM_EMMC))
    config ENV_IN_SERIAL_512K
        bool "Serial_512K"
    endif
    config ENV_IN_ERR
        bool "Error"

#    if (NAND_FLASH)
#    config ENV_IN_NAND
#        bool "Nand"
#	    if (UBI && UBI_FS)
#        config ENV_IN_UBI
#            bool "Nand UBI"
#        endif
#        config ENV_IN_SERIAL
#            bool "Serial"
#    endif
#
#    if (FLASH)
#    config ENV_IN_SERIAL
#        bool "Serial"
#    endif
#
#    config ENV_IN_ERR
#        bool "Error"

endchoice

if (USB || OAD)
choice
    prompt "Info Exchange Config"
    default INFO_IN_UBI_FILE if (NAND_FLASH && UBI && UBI_FS)
    default INFO_IN_SERIAL_ENV if (ENV_IN_SERIAL)
    default INFO_IN_MMC if (ENV_IN_MMC)

    if (NAND_FLASH)
        if (UBI && UBI_FS)
        config INFO_IN_UBI_FILE
            bool "Nand UBI File"
        endif
    endif
    if(!BOOT_FROM_NAND)
    if (ENV_IN_SERIAL)
    config INFO_IN_SERIAL_ENV
        bool "Serial ENV"
    endif
    if (ENV_IN_MMC)
    config INFO_IN_MMC_ENV
        bool "e-MMC ENV"
    endif
    endif

    config INFO_IN_ERR
        bool "Error"

endchoice
endif

endmenu
```
